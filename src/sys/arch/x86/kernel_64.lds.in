/*
 *
 * Idylla Operating System
 * Copyright (C) 2009-2010  Idylla Operating System Team
 *
 * This program is free software: you can redistribute it and/or modify
 * it under the terms of the GNU General Public License as published by
 * the Free Software Foundation, either version 3 of the License, or
 * (at your option) any later version.
 *
 * This program is distributed in the hope that it will be useful,
 * but WITHOUT ANY WARRANTY; without even the implied warranty of
 * MERCHANTABILITY or FITNESS FOR A PARTICULAR PURPOSE.  See the
 * GNU General Public License for more details.
 *
 * You should have received a copy of the GNU General Public License
 * along with this program.  If not, see <http://www.gnu.org/licenses/>.
 *
*/
ENTRY(_start)
OUTPUT_ARCH(i386:x86-64)
OUTPUT_FORMAT("elf64-x86-64")

KERNEL_VIRT_ADDR = 0xFFFF800000000000 + __CONFIG_KLOAD_ADDR;
PAGE_SIZE = 0x1000;

SECTIONS
{
    .text KERNEL_VIRT_ADDR :
    {
	_text = .;
	*(.header)
        *(.text)
        *(.rodata*)
	_etext = .;
    }

    .data ALIGN (PAGE_SIZE) :
    {
	_data = .;
        *(.data)
	_edata = .;
    }

    .bss ALIGN (PAGE_SIZE) :
    {
        _bss = .;
	*(.bss)
	*(COMMON)
	. = ALIGN(PAGE_SIZE);
        _ebss = .;
    }
    _end = .;
}
